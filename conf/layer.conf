## conf/layer.conf
```bitbake
# We have a conf and classes directory, add to BBPATH
BBPATH .= ":${LAYERDIR}"

# We have recipes-* directories, add to BBFILES
BBFILES += "${LAYERDIR}/recipes-*/*/*.bb ${LAYERDIR}/recipes-*/*/*.bbappend ${LAYERDIR}/images/*.bb"

BBFILE_COLLECTIONS += "ipc"

BBFILE_PATTERN_ipc = "^${LAYERDIR}/"
# Set prio to be greater than the prio of the meta-oe (because of clash with capnproto and cppzmq)
BBFILE_PRIORITY_ipc = "7"
LAYERSERIES_COMPAT_ipc = "dunfell"
```
